// DmxOut.cpp  (Hazer-RX)
// Streams full 512-channel DMX frames continuously (~44 Hz) from a FreeRTOS task.
// Break is generated by the UART driver (appended after each frame, so it acts as
// the break before the next one). DE/RE are tied together and held HIGH because
// this node only ever transmits.
#include <Arduino.h>
#include "driver/uart.h"
#include "Config.h"
#include "DmxOut.h"

static const uart_port_t DMX_PORT = (uart_port_t)DMX_UART_NUM;
static volatile uint8_t frame[513];     // [0] = start code, [1..512] = channels
static bool started = false;

static void dmxTask(void*) {
  static uint8_t buf[513];
  for (;;) {
    for (int i = 0; i < 513; i++) buf[i] = frame[i];
    buf[0] = 0;                                         // start code
    // 24 bit-times at 250 kbaud = 96 us break (DMX requires >= 88 us)
    uart_write_bytes_with_break(DMX_PORT, (const char*)buf, 513, 24);
    uart_wait_tx_done(DMX_PORT, pdMS_TO_TICKS(100));
    vTaskDelay(1);
  }
}

void dmxBegin() {
  memset((void*)frame, 0, sizeof(frame));
  if (DMX_DI_PIN < 0) {
    Serial.println("[DMX] DMX_DI_PIN not set in Config.h - DMX output disabled");
    return;
  }
  if (DMX_EN_PIN >= 0) {
    pinMode(DMX_EN_PIN, OUTPUT);
    digitalWrite(DMX_EN_PIN, HIGH);                     // transmit, receiver off
  }

  uart_config_t c = {};
  c.baud_rate           = 250000;
  c.data_bits           = UART_DATA_8_BITS;
  c.parity              = UART_PARITY_DISABLE;
  c.stop_bits           = UART_STOP_BITS_2;
  c.flow_ctrl           = UART_HW_FLOWCTRL_DISABLE;
  c.rx_flow_ctrl_thresh = 0;
  c.source_clk          = UART_SCLK_DEFAULT;

  uart_driver_install(DMX_PORT, 256, 1024, 0, NULL, 0);
  uart_param_config(DMX_PORT, &c);
  uart_set_pin(DMX_PORT, DMX_DI_PIN,
               (DMX_RO_PIN >= 0) ? DMX_RO_PIN : UART_PIN_NO_CHANGE,
               UART_PIN_NO_CHANGE, UART_PIN_NO_CHANGE);

  xTaskCreate(dmxTask, "dmx", 3072, NULL, 2, NULL);
  started = true;
  Serial.println("[DMX] output started");
}

void dmxSetChannel(uint16_t ch, uint8_t v) {
  if (ch >= 1 && ch <= 512) frame[ch] = v;
}

uint8_t dmxGetChannel(uint16_t ch) {
  return (ch >= 1 && ch <= 512) ? frame[ch] : 0;
}

void dmxZeroAll() {
  for (int i = 1; i <= 512; i++) frame[i] = 0;
}
